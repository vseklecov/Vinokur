#include <avr/pgmspace.h>

const float steam[218] PROGMEM = {
          96.3,95.2,94.7,94.2,93.8,93.1,92.7,92.2, // 78.2 - 78.9
91.9,91.6,91.2,90.8,90.5,90.1,89.6,89.1,88.4,88.1, // 79.0 - 79.9
87.8,87.4,87.2,87.0,86.8,86.3,86.1,85.8,85.6,85.4, // 80.0 - 80.9
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11.2,10.0, 8.9, 7.6, 6.1, 4.8, 3.3, 2.5, 1.6, 0.2  // 99.0 - 99.9
};

const float liq[] PROGMEM = {
          96.1,94.7,94.0,93.3,92.5,91.4,90.7,89.9, // 78.2 - 78.9
89.2,88.7,87.9,87.1,86.3,85.5,84.3,83.0,80.9,80.0, // 79.0 - 79.9
78.7,77.8,77.0,76.1,75.2,73.3,72.4,71.0,70.1,69.2, // 80.0 - 80.9
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 1.0, 0.9, 0.8, 0.6, 0.5, 0.4, 0.3, 0.2, 0.1, 0.0  // 99.0 - 99.9
};
 
float alcSteam(float temp) {
  if (temp<78.2 || temp>99.9)
    return 0.0;
  else
    return pgm_read_float_near(steam+(int)(temp*10)-782);
}

float alcLiq(float temp) {
  if (temp<78.2 || temp>99.9)
    return 0.0;
  else
    return pgm_read_float_near(liq+(int)(temp*10)-782);
}

// f - формат (1-'YYYY-MM-DD HH:MM:SS', 2-'HH:MM:SS', 3-'HH:MM')
String formatTime(byte f=2, time_t t=0) {
  if (t==0)
    t = now();
  switch (f)
  {
    case 1:
      return String(year(t))+"-"+two(month(t))+"-"+two(day(t))+" "+two(hour(t))+":"+two(minute(t))+":"+two(second(t));
    case 2:
      return two(hour(t))+":"+two(minute(t))+":"+two(second(t));
    case 3:
      return two(hour(t))+":"+two(minute(t));
  }
  return "";
}


String two(int num) {
  if (num<10) {
    return "0"+String(num);
  } else {
    return String(num);
  }
}

